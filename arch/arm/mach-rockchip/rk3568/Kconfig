## arch/arm/mach-rockchip/rk3568/Kconfig
```kconfig
if ROCKCHIP_RK3568

choice
	prompt "RK356x board select"

config TARGET_EVB_RK3568
	bool "EVB_RK3568"
	select BOARD_LATE_INIT
	help
	  RK3568 EVB is a evaluation board for Rockchp RK3568.

config TARGET_YF_RK3566
	bool "YF_RK3566"
	select BOARD_LATE_INIT
	help
	 RK3566 yf 023 v6  board

endchoice

config SYS_SOC
	default "rockchip"

config SYS_MALLOC_F_LEN
	default 0x400

source board/rockchip/evb_rk3568/Kconfig
source board/rockchip/yf_rk3566/Kconfig

endif
```

## board/rockchip/yf_rk3566/Kconfig
```kconfig
if TARGET_YF_RK3566

config SYS_BOARD
	default "yf_rk3566"

config SYS_VENDOR
	default "rockchip"

config SYS_CONFIG_NAME
	default "evb_rk3568"

config BOARD_SPECIFIC_OPTIONS # dummy
	def_bool y

endif
```
